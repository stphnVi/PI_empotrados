## poky/rpi4/conf/bblayers.conf
```bitbake
# POKY_BBLAYERS_CONF_VERSION is increased each time build/conf/bblayers.conf
# changes incompatibly
POKY_BBLAYERS_CONF_VERSION = "2"

BBPATH = "${TOPDIR}"
BBFILES ?= ""

BBLAYERS ?= " \
  /home/katharsis/Documents/TEC/1S2025/Empotrados/Proyectos/PG1/poky/meta \
  /home/katharsis/Documents/TEC/1S2025/Empotrados/Proyectos/PG1/poky/meta-poky \
  /home/katharsis/Documents/TEC/1S2025/Empotrados/Proyectos/PG1/poky/meta-yocto-bsp \
  /home/katharsis/Documents/TEC/1S2025/Empotrados/Proyectos/PG1/poky/meta-raspberrypi \
  /home/katharsis/Documents/TEC/1S2025/Empotrados/Proyectos/PG1/poky/meta-webcam \
  "
```
